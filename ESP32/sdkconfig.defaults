## ESP32S3/sdkconfig.defaults
```kconfig
# CYM ESP32-S3 shared base sdkconfig defaults
# Applies to all ESP32-S3 (Xtensa LX7 dual-core) boards.

# PSRAM (all Hosyond S3 boards have 8 MB OPI PSRAM)
CONFIG_SPIRAM=y
CONFIG_SPIRAM_USE_MALLOC=y
CONFIG_SPIRAM_ALLOW_BSS_SEG_EXTERNAL_MEMORY=y
CONFIG_SPIRAM_ALLOW_STACK_EXTERNAL_MEMORY=y
CONFIG_SPIRAM_SPEED_80M=y
CONFIG_SPIRAM_MALLOC_RESERVE_INTERNAL=61440

# WiFi buffers (same tuning as C5)
CONFIG_ESP_WIFI_STATIC_RX_BUFFER_NUM=4
CONFIG_ESP_WIFI_STATIC_TX_BUFFER_NUM=3

# Main task stack
CONFIG_ESP_MAIN_TASK_STACK_SIZE=8192

# Partition table
CONFIG_PARTITION_TABLE_CUSTOM=y
CONFIG_PARTITION_TABLE_CUSTOM_FILENAME="partitions.csv"

# Task WDT
CONFIG_ESP_TASK_WDT_PANIC=y
CONFIG_ESP_TASK_WDT_TIMEOUT_S=30

# Bluetooth (NimBLE + extended advertising for wardrive coexistence)
CONFIG_BT_ENABLED=y
CONFIG_BT_NIMBLE_ENABLED=y
CONFIG_BT_NIMBLE_EXT_ADV=y
CONFIG_BT_NIMBLE_MEM_ALLOC_MODE_INTERNAL=y
CONFIG_BT_NIMBLE_MSYS_1_BLOCK_COUNT=6
CONFIG_BT_NIMBLE_MSYS_2_BLOCK_COUNT=12
CONFIG_BT_NIMBLE_MSYS1_BLOCK_COUNT=6
CONFIG_BT_NIMBLE_ACL_BUF_COUNT=5
CONFIG_BT_NIMBLE_HCI_EVT_HI_BUF_COUNT=8
CONFIG_BT_NIMBLE_HCI_EVT_LO_BUF_COUNT=4
CONFIG_BT_NIMBLE_ATT_MAX_PREP_ENTRIES=4

# WiFi + BLE coexistence
CONFIG_ESP_COEX_SW_COEXIST_ENABLE=y

# LVGL
CONFIG_LV_FONT_MONTSERRAT_12=y
CONFIG_LV_FONT_MONTSERRAT_16=y
CONFIG_LV_FONT_MONTSERRAT_20=y
CONFIG_LV_FONT_MONTSERRAT_28=y
CONFIG_LV_MEM_CUSTOM=y
CONFIG_LV_MEM_CUSTOM_INCLUDE="lvgl_memory.h"
CONFIG_LV_COLOR_16_SWAP=y
CONFIG_LV_MEMCPY_MEMSET_STD=y
CONFIG_LV_DISP_DEF_REFR_PERIOD=15

# Compiler optimization
CONFIG_COMPILER_OPTIMIZATION_PERF=y

# mbedTLS (same tuning as C5)
CONFIG_MBEDTLS_EXTERNAL_MEM_ALLOC=y
CONFIG_MBEDTLS_DYNAMIC_BUFFER=y
CONFIG_MBEDTLS_HARDWARE_AES=n
CONFIG_MBEDTLS_HARDWARE_ECC=n
CONFIG_MBEDTLS_CERTIFICATE_BUNDLE_DEFAULT_CMN=y

# Panic handler in IRAM
CONFIG_ESP_PANIC_HANDLER_IRAM=y
```
