## ESP32C5/sdkconfig.defaults
```kconfig
# NM-CYD-C5 project defaults
# These override the chip defaults and are preserved across set-target/fullclean

# Main task stack — must be large enough for LVGL UI construction + large local buffers
CONFIG_ESP_MAIN_TASK_STACK_SIZE=8192

# Coexistence: WiFi + BLE + 802.15.4 share the single RF front-end via software
# arbitration. Required for wardrive simultaneous WiFi+BLE scanning and for the
# Zigbee Scout passive 802.15.4 capture feature.
CONFIG_ESP_COEX_SW_COEXIST_ENABLE=y

# IEEE 802.15.4 (Zigbee/Thread passive scanner via built-in ESP32-C5 radio)
CONFIG_IEEE802154_ENABLED=y

# Bluetooth / NimBLE
CONFIG_BT_ENABLED=y
CONFIG_BT_NIMBLE_ENABLED=y
CONFIG_BT_NIMBLE_EXT_ADV=y
# NimBLE host buffers (MSYS/ACL/HCI) MUST be in internal DRAM — not PSRAM.
# The BLE LL ISR (ROM code) accesses MSYS pool at interrupt level; PSRAM addresses
# get corrupted by ROM pointer tagging → Load access fault. EXTERNAL mode is
# incompatible with ESP32-C5 BLE ROM. Use INTERNAL to force DRAM allocation.
CONFIG_BT_NIMBLE_MEM_ALLOC_MODE_INTERNAL=y
# NimBLE host buffer counts. MSYS2 increased from 5→12 to prevent rc=3
# (BLE_ERR_MEM_CAPACITY) during BLE Spam extended advertising cycles.
# MSYS1(6×128=768) + MSYS2(12×320=3840) + ACL(5×255=1275) + HCI_HI(8×70=560) +
# HCI_LO(4×70=280) = 6723 bytes total internal DRAM.
CONFIG_BT_NIMBLE_MSYS_1_BLOCK_COUNT=6
CONFIG_BT_NIMBLE_MSYS_2_BLOCK_COUNT=12
CONFIG_BT_NIMBLE_MSYS1_BLOCK_COUNT=6
CONFIG_BT_NIMBLE_ACL_BUF_COUNT=5
CONFIG_BT_NIMBLE_HCI_EVT_HI_BUF_COUNT=8
CONFIG_BT_NIMBLE_HCI_EVT_LO_BUF_COUNT=4

# PSRAM (8 MB SPIRAM on NM-CYD-C5)
CONFIG_SPIRAM=y
CONFIG_SPIRAM_USE_MALLOC=y
CONFIG_SPIRAM_ALLOW_BSS_SEG_EXTERNAL_MEMORY=y
CONFIG_SPIRAM_ALLOW_STACK_EXTERNAL_MEMORY=y
# DMA reserve pool: 60 KB. WiFi static RX (4×1700=6.8KB) + TX (3×~1700=5.1KB)
# + BLE LL (~18KB) + LCD draw buffers (PSRAM via GDMA cache-transparent) ≈ 30KB used.
# 60KB gives ~30KB free at wardrive+promisc start, enough for SD SPI and mbuf headroom.
CONFIG_SPIRAM_MALLOC_RESERVE_INTERNAL=61440
# WiFi RX: 4 static buffers. TX: 3 static buffers (minimum tested to work).
CONFIG_ESP_WIFI_STATIC_RX_BUFFER_NUM=4
CONFIG_ESP_WIFI_STATIC_TX_BUFFER_NUM=3

# LVGL fonts used by the UI
CONFIG_LV_FONT_MONTSERRAT_12=y
CONFIG_LV_FONT_MONTSERRAT_16=y
CONFIG_LV_FONT_MONTSERRAT_20=y
CONFIG_LV_FONT_MONTSERRAT_28=y

# Flash size (NM-CYD-C5 has 16 MB flash)
CONFIG_ESPTOOLPY_FLASHSIZE_16MB=y
CONFIG_ESPTOOLPY_FLASHSIZE="16MB"

# Partition table
CONFIG_PARTITION_TABLE_CUSTOM=y
CONFIG_PARTITION_TABLE_CUSTOM_FILENAME="partitions.csv"

# Panic handler in IRAM — must be set so the panic/backtrace handler can execute
# even when the flash cache is temporarily disabled (e.g. during NVS/flash writes).
# Without this, any fault that fires during a cache-dark window causes CPU_LOCKUP
# because the panic handler can't fetch its own code from flash.
CONFIG_ESP_PANIC_HANDLER_IRAM=y

# Task WDT panic — converts silent watchdog reboot into a full panic with register
# dump and backtrace so we can see which task/line caused the hang.
CONFIG_ESP_TASK_WDT_PANIC=y
# WDT timeout: 30 s. Default (5 s) is too short for software P-384 ECC during
# WiGLE TLS handshake (ISRG Root X2 chain). Software ECC + AES can stall for >5 s.
CONFIG_ESP_TASK_WDT_TIMEOUT_S=30

# mbedTLS memory — FORCE all mbedTLS allocations to PSRAM (EXTERNAL).
# DEFAULT_MEM_ALLOC does NOT reliably use PSRAM — sub-16KB allocations land in
# internal DRAM due to SPIRAM_MALLOC_ALWAYSINTERNAL=16384, exhausting the DMA pool
# during WiGLE/WPA-SEC TLS handshake. EXTERNAL_MEM_ALLOC sends every mbedTLS block
# to PSRAM. Hardware AES/ECC disabled so TLS buffers never need DMA.
CONFIG_MBEDTLS_EXTERNAL_MEM_ALLOC=y
CONFIG_MBEDTLS_DYNAMIC_BUFFER=y
# Hardware AES needs DMA-capable internal RAM. With LCD + WiFi consuming the DMA pool
# there isn't enough headroom. Software AES uses PSRAM via SPIRAM_USE_MALLOC.
CONFIG_MBEDTLS_HARDWARE_AES=n
# Hardware ECC on ESP32-C5 only supports P-192/P-256. Let's Encrypt E-series CAs
# use P-384 (ISRG Root X2) — hardware ECC returns error on P-384. Use software.
CONFIG_MBEDTLS_HARDWARE_ECC=n

# Smaller CA bundle — "common" set covers every major commercial CA
# (Amazon, DigiCert, Let's Encrypt, Comodo, GeoTrust, etc.) used by
# WiGLE and WDGWars, while consuming ~60 % less flash/parse overhead
# than the full Mozilla bundle.
CONFIG_MBEDTLS_CERTIFICATE_BUNDLE_DEFAULT_CMN=y

# LVGL custom memory allocator — route all LVGL heap through our PSRAM-preferring
# wrapper (lvgl_malloc/free/realloc) so LVGL objects land in PSRAM instead of the
# scarce internal DRAM/RTCRAM, preventing heap corruption under WiFi/BLE pressure.
CONFIG_LV_MEM_CUSTOM=y
CONFIG_LV_MEM_CUSTOM_INCLUDE="lvgl_memory.h"

# ST7789 byte-order fix — CRITICAL. The ST7789 expects RGB565 pixels big-endian
# (high byte first). Without this LVGL sends them little-endian, swapping every
# pixel's bytes and producing full-screen color corruption.
# THIS MUST STAY IN sdkconfig.defaults — it is NOT set by any IDF chip default.
# Every idf.py fullclean + set-target will silently drop it otherwise.
# Verified fix in v2.10.13. See CLAUDE.md "ST7789 color byte-order fix" section.
CONFIG_LV_COLOR_16_SWAP=y
```
